## boards/shields/claude_view/dts/bindings/zmk,behavior-anim-next.yaml
```yaml
description: |
  Cycle to the next display animation (wraps around).
  Use as:  &anim_next

compatible: "zmk,behavior-anim-next"

properties:
  "#binding-cells":
    type: int
    const: 0
```

## boards/shields/claude_view/dts/bindings/zmk,behavior-anim-select.yaml
```yaml
description: |
  Select a display animation by index.
  Use as:  &anim_select 0   (wave)
           &anim_select 1   (gym)

compatible: "zmk,behavior-anim-select"

properties:
  "#binding-cells":
    type: int
    const: 1
```

## dts/bindings/zmk,behavior-anim-cycle.yaml
```yaml
description: |
  Advance to the next Claude View animation on the peripheral (wraps).
  Uses BEHAVIOR_LOCALITY_GLOBAL — forwarded over split BLE like RGB underglow.

compatible: "zmk,behavior-anim-cycle"

include: zero_param.yaml
```

## dts/bindings/zmk,behavior-anim-pick.yaml
```yaml
description: |
  Select Claude View mascot animation by index on the Bluetooth peripheral half.
  Uses BEHAVIOR_LOCALITY_GLOBAL so the central half forwards this behavior over
  ZMK's existing split "run behavior" GATT write (same pipe as RGB underglow).

  Example: &anim_pick 0 (wave), &anim_pick 1 (gym).

compatible: "zmk,behavior-anim-pick"

include: one_param.yaml
```

## dts/bindings/zmk,behavior-anim-set.yaml
```yaml
description: |
  Select a fixed Claude View animation index on the display half (no parameters).
  Uses BEHAVIOR_LOCALITY_GLOBAL — forwarded over split BLE like RGB underglow.
  Split BLE only passes a 9-char behavior name; parametric anim_pick is unreliable.

compatible: "zmk,behavior-anim-set"

include: zero_param.yaml

properties:
  animation-index:
    type: int
    required: true
```
